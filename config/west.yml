## config/west.yml
```yaml
manifest:
  remotes:
    - name: zmkfirmware
      url-base: https://github.com/zmkfirmware
    - name: inorichi
      url-base: https://github.com/inorichi
    - name: keyfreaks
      url-base: https://github.com/kay-yokoyama
    - name: caksoylar
      url-base: https://github.com/caksoylar
    - name: oleksandrmaslov # ← 追加
      url-base: https://github.com/oleksandrmaslov # ← 追加
    - name: kot149 # ←追加
      url-base: https://github.com/kot149 # ← 追加
  projects:
    - name: zmk
      remote: zmkfirmware
      revision: v0.2.1
      import: app/west.yml
    - name: zmk-pmw3610-driver
      remote: inorichi
      revision: main
    - name: zmk-rgbled-widget
      remote: caksoylar
      revision: v0.3-branch
    - name: zmk-pointing-acceleration # ← 追加
      remote: oleksandrmaslov # ← 追加
      revision: main # ← 追加
    - name: zmk-scroll-snap # ←追加
      remote: kot149 # ←追加
      revision: v1 # ←追加
  self:
    path: config
```
